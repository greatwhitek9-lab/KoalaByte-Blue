## CMakeLists.txt
```
cmake_minimum_required(VERSION 3.20.0)
find_package(Zephyr REQUIRED HINTS $ENV{ZEPHYR_BASE})
project(koalabyte_t114_boot_probe)

target_sources(app PRIVATE src/main.c)
```

## prj.conf
```kconfig
# Minimal Heltec T114 bootability probe for the HT-n5262 UF2 bootloader.
# Deliberately excludes display, Bluetooth, GNSS, LoRa, SPI and application storage.

CONFIG_MAIN_STACK_SIZE=2048
CONFIG_PRINTK=y
CONFIG_LOG=n

CONFIG_BUILD_OUTPUT_UF2=y

CONFIG_GPIO=y
CONFIG_SERIAL=y
CONFIG_CONSOLE=y
CONFIG_UART_CONSOLE=y
CONFIG_USB_DEVICE_STACK=y
CONFIG_USB_CDC_ACM=y
CONFIG_UART_LINE_CTRL=y

CONFIG_BT=n
CONFIG_DISPLAY=n
CONFIG_GNSS=n
CONFIG_LORA=n
CONFIG_SPI=n
CONFIG_SENSOR=n
```

## src/main.c
```c
#include <zephyr/device.h>
#include <zephyr/devicetree.h>
#include <zephyr/drivers/gpio.h>
#include <zephyr/kernel.h>
#include <zephyr/sys/printk.h>
#include <zephyr/usb/usb_device.h>

#define LED0_NODE DT_ALIAS(led0)

#if !DT_NODE_HAS_STATUS(LED0_NODE, okay)
#error "Heltec T114 boot probe requires the led0 alias"
#endif

static const struct gpio_dt_spec status_led = GPIO_DT_SPEC_GET(LED0_NODE, gpios);

int main(void)
{
    int led_rc;
    int usb_rc;
    bool led_on = false;
    uint32_t heartbeat = 0;

    led_rc = gpio_is_ready_dt(&status_led)
                 ? gpio_pin_configure_dt(&status_led, GPIO_OUTPUT_INACTIVE)
                 : -ENODEV;

    usb_rc = usb_enable(NULL);
    k_sleep(K_MSEC(1200));

    printk("{\"type\":\"t114_boot_probe\",\"stage\":\"started\","
           "\"profile\":\"usb_led_only\",\"display\":false,"
           "\"bluetooth\":false,\"gnss\":false,\"lora\":false,"
           "\"led_rc\":%d,\"usb_rc\":%d}\n",
           led_rc, usb_rc);

    while (true) {
        if (led_rc == 0) {
            led_on = !led_on;
            (void)gpio_pin_set_dt(&status_led, led_on ? 1 : 0);
        }

        printk("{\"type\":\"t114_boot_probe\",\"stage\":\"heartbeat\","
               "\"count\":%u,\"uptime_ms\":%lld}\n",
               heartbeat++, (long long)k_uptime_get());

        k_sleep(K_SECONDS(1));
    }

    return 0;
}
```
