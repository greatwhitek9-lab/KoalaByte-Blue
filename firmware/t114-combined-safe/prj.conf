## CMakeLists.txt
```
cmake_minimum_required(VERSION 3.20.0)
find_package(Zephyr REQUIRED HINTS $ENV{ZEPHYR_BASE})
project(koalabyte_t114_combined_safe)

set(KOALABYTE_TONE_MAIN_SOURCE
  ${CMAKE_CURRENT_BINARY_DIR}/generated/koalabyte_t114_tone_main.c
)
set(KOALABYTE_PROTOCOL_MAIN_SOURCE
  ${CMAKE_CURRENT_BINARY_DIR}/generated/koalabyte_t114_protocol_main.c
)
set(KOALABYTE_FINAL_MAIN_SOURCE
  ${CMAKE_CURRENT_BINARY_DIR}/generated/koalabyte_t114_deployable_main.c
)
file(MAKE_DIRECTORY ${CMAKE_CURRENT_BINARY_DIR}/generated)
execute_process(
  COMMAND
    ${PYTHON_EXECUTABLE}
    ${CMAKE_CURRENT_SOURCE_DIR}/scripts/generate_tone_aware_main.py
    --source ${CMAKE_CURRENT_SOURCE_DIR}/src/main.c
    --output ${KOALABYTE_TONE_MAIN_SOURCE}
  RESULT_VARIABLE KOALABYTE_TONE_MAIN_RESULT
  ERROR_VARIABLE KOALABYTE_TONE_MAIN_ERROR
)
if(NOT KOALABYTE_TONE_MAIN_RESULT EQUAL 0)
  message(FATAL_ERROR
    "Failed to generate tone-aware T114 main source: ${KOALABYTE_TONE_MAIN_ERROR}"
  )
endif()
execute_process(
  COMMAND
    ${PYTHON_EXECUTABLE}
    ${CMAKE_CURRENT_SOURCE_DIR}/scripts/patch_protocol_status.py
    --source ${KOALABYTE_TONE_MAIN_SOURCE}
    --output ${KOALABYTE_PROTOCOL_MAIN_SOURCE}
  RESULT_VARIABLE KOALABYTE_PROTOCOL_PATCH_RESULT
  ERROR_VARIABLE KOALABYTE_PROTOCOL_PATCH_ERROR
)
if(NOT KOALABYTE_PROTOCOL_PATCH_RESULT EQUAL 0)
  message(FATAL_ERROR
    "Failed to add T114 protocol status: ${KOALABYTE_PROTOCOL_PATCH_ERROR}"
  )
endif()
execute_process(
  COMMAND
    ${PYTHON_EXECUTABLE}
    ${CMAKE_CURRENT_SOURCE_DIR}/scripts/patch_uf2_bootloader_entry.py
    --source ${KOALABYTE_PROTOCOL_MAIN_SOURCE}
    --output ${KOALABYTE_FINAL_MAIN_SOURCE}
  RESULT_VARIABLE KOALABYTE_BOOTLOADER_PATCH_RESULT
  ERROR_VARIABLE KOALABYTE_BOOTLOADER_PATCH_ERROR
)
if(NOT KOALABYTE_BOOTLOADER_PATCH_RESULT EQUAL 0)
  message(FATAL_ERROR
    "Failed to add T114 software UF2 entry: ${KOALABYTE_BOOTLOADER_PATCH_ERROR}"
  )
endif()
set_source_files_properties(${KOALABYTE_FINAL_MAIN_SOURCE} PROPERTIES GENERATED TRUE)

target_sources(app PRIVATE
  src/display_power_init.c
  src/koalagotchi_lifecycle_wrapper.c
  src/centered_koalagotchi_renderer.c
  src/stateful_koalagotchi_overlay.c
  src/koala_abs_compat.c
  ${KOALABYTE_FINAL_MAIN_SOURCE}
  src/loading_display.c
  src/original_texture_warp_renderer.c
)
target_include_directories(app PRIVATE ${CMAKE_CURRENT_SOURCE_DIR}/src)

# Direct symbol routing keeps the Koalagotchi lifecycle latch as the public API.
# loading_display.c still owns boot/menu/action drawing. The normal mouth path is
# provided by original_texture_warp_renderer.c, which continuously deforms one
# approved original texture and never compiles the procedural replacement mouth.
# The canonical centered renderer is compiled as a private base frame; the
# stateful overlay owns the public centered action symbol and adds live
# health/mood/expression/progress without creating another full-screen buffer.
set_source_files_properties(src/loading_display.c PROPERTIES
  COMPILE_DEFINITIONS
    "render_killerkoala_mouth=koala_base_render_killerkoala_mouth;render_menu_status=koala_base_render_menu_status;render_koalagotchi_action=koala_base_render_koalagotchi_action"
)
set_source_files_properties(src/centered_koalagotchi_renderer.c PROPERTIES
  COMPILE_DEFINITIONS
    "koala_centered_render_koalagotchi_action=koala_centered_render_koalagotchi_action_base"
)
set_source_files_properties(src/original_texture_warp_renderer.c PROPERTIES
  COMPILE_DEFINITIONS
    "koala_base_render_koalagotchi_action=koala_centered_render_koalagotchi_action"
)
set_source_files_properties(src/koalagotchi_lifecycle_wrapper.c PROPERTIES
  COMPILE_DEFINITIONS
    "__wrap_render_killerkoala_mouth=render_killerkoala_mouth;__wrap_render_menu_status=render_menu_status;__wrap_render_koalagotchi_action=render_koalagotchi_action;__real_render_killerkoala_mouth=koala_original_render_killerkoala_mouth;__real_render_menu_status=koala_original_render_menu_status;__real_render_koalagotchi_action=koala_centered_render_koalagotchi_action;koala_inner_render_killerkoala_mouth=koala_original_render_killerkoala_mouth;koala_inner_render_menu_status=koala_original_render_menu_status;koala_inner_render_koalagotchi_action=koala_centered_render_koalagotchi_action"
)

set(KOALABYTE_BOOT_SPLASH_ASSET
  ${CMAKE_CURRENT_SOURCE_DIR}/assets/killerkoala-bootsplash-240x135.rgb565be
)
set(KOALABYTE_BOOT_SPLASH_INCLUDE
  ${ZEPHYR_BINARY_DIR}/include/generated/killerkoala_boot_splash_rgb565.inc
)
generate_inc_file_for_target(
  app
  ${KOALABYTE_BOOT_SPLASH_ASSET}
  ${KOALABYTE_BOOT_SPLASH_INCLUDE}
)

foreach(KOALABYTE_MOUTH_EXPRESSION IN ITEMS
    smile
    happy
    bite
    snarl
    sideways_grin
  )
  string(REPLACE "_" "-" KOALABYTE_MOUTH_ASSET_NAME
    ${KOALABYTE_MOUTH_EXPRESSION}
  )
  if(KOALABYTE_MOUTH_EXPRESSION STREQUAL "smile")
    set(KOALABYTE_MOUTH_SHA256 4ac8487889927f12245b7aab18bcbae67a136d435bedfbc12d64b6438b325c0b)
  elseif(KOALABYTE_MOUTH_EXPRESSION STREQUAL "happy")
    set(KOALABYTE_MOUTH_SHA256 16753b3a5ae15a9946c7a519203d181ac4c1d21a121f7de6699497bbc96c4f00)
  elseif(KOALABYTE_MOUTH_EXPRESSION STREQUAL "bite")
    set(KOALABYTE_MOUTH_SHA256 7473bc86850497c03067fce47f3bd2bdf6166ca0ac1cbc14f19dc579adac93cd)
  elseif(KOALABYTE_MOUTH_EXPRESSION STREQUAL "snarl")
    set(KOALABYTE_MOUTH_SHA256 265f944b10b4cab58ee0d84b5e67fbec805a2cd7774829641697a3077f058ed0)
  elseif(KOALABYTE_MOUTH_EXPRESSION STREQUAL "sideways_grin")
    set(KOALABYTE_MOUTH_SHA256 2698c29d589abe9b3582be48f630da71ce0c3051d7656d7f4ba57556fd435e49)
  endif()
  set(KOALABYTE_MOUTH_ASSET_PREFIX
    ${CMAKE_CURRENT_SOURCE_DIR}/assets/killerkoala-cyber-mouth-${KOALABYTE_MOUTH_ASSET_NAME}-240x135.rgb565be.b64
  )
  set(KOALABYTE_MOUTH_DECODED
    ${ZEPHYR_BINARY_DIR}/generated/killerkoala-cyber-mouth-${KOALABYTE_MOUTH_ASSET_NAME}-240x135.rgb565be
  )
  set(KOALABYTE_MOUTH_INCLUDE
    ${ZEPHYR_BINARY_DIR}/include/generated/killerkoala_cyber_mouth_${KOALABYTE_MOUTH_EXPRESSION}_rgb565.inc
  )
  execute_process(
    COMMAND
      ${PYTHON_EXECUTABLE}
      ${CMAKE_CURRENT_SOURCE_DIR}/scripts/decode_base64_asset.py
      --expected-bytes 64800
      --expected-sha256 ${KOALABYTE_MOUTH_SHA256}
      --output ${KOALABYTE_MOUTH_DECODED}
      ${KOALABYTE_MOUTH_ASSET_PREFIX}.part0
      ${KOALABYTE_MOUTH_ASSET_PREFIX}.part1
    RESULT_VARIABLE KOALABYTE_MOUTH_DECODE_RESULT
    ERROR_VARIABLE KOALABYTE_MOUTH_DECODE_ERROR
  )
  if(NOT KOALABYTE_MOUTH_DECODE_RESULT EQUAL 0)
    message(FATAL_ERROR
      "Failed to decode ${KOALABYTE_MOUTH_EXPRESSION} mouth asset: ${KOALABYTE_MOUTH_DECODE_ERROR}"
    )
  endif()
  generate_inc_file_for_target(
    app
    ${KOALABYTE_MOUTH_DECODED}
    ${KOALABYTE_MOUTH_INCLUDE}
  )
endforeach()

if(DEFINED KOALABYTE_GNSS_UART_LABEL)
  target_compile_definitions(app PRIVATE KOALABYTE_GNSS_UART_LABEL="${KOALABYTE_GNSS_UART_LABEL}")
endif()
```

## prj.conf
```kconfig
# KoalaByte Blue Heltec T114 combined-safe firmware
# Primary role: Heltec onboard nRF52840 is the canonical passive BLE node.
# Secondary BLE nodes remain ESP32-S3 DualEye and Raspberry Pi BlueZ on the Pi side.

CONFIG_MAIN_STACK_SIZE=4096
CONFIG_HEAP_MEM_POOL_SIZE=2048
CONFIG_PRINTK=y
CONFIG_LOG=n
CONFIG_REBOOT=y

# Produce a drag-and-drop UF2 artifact for the Heltec/Waveshare-style
# double-reset bootloader volume that appears as HT-n5262.
CONFIG_BUILD_OUTPUT_UF2=y

# Heltec T114 v2 onboard ST7789 in right-rotated 240x135 landscape. Loading text is rendered here
# while the ESP32-S3 DualEye keeps the KillerKoala AI eyes active.
CONFIG_GPIO=y
CONFIG_DISPLAY=y
CONFIG_ST7789V=y

# USB CDC serial JSON transport to the Raspberry Pi companion.
CONFIG_SERIAL=y
CONFIG_CONSOLE=y
CONFIG_UART_CONSOLE=y
CONFIG_UART_INTERRUPT_DRIVEN=n
CONFIG_USB_DEVICE_STACK=y
CONFIG_USB_CDC_ACM=y
CONFIG_UART_LINE_CTRL=y

# Local BLE application mode. This is not HCI USB mode; it emits normalized JSON.
CONFIG_BT=y
CONFIG_BT_OBSERVER=y
CONFIG_BT_BROADCASTER=y
CONFIG_BT_CENTRAL=n
CONFIG_BT_PERIPHERAL=n
CONFIG_BT_DEVICE_NAME="KoalaByte-T114"

# Keep the firmware passive by default. Transmit is Pi-commanded and limited to
# a non-connectable owned-lab beacon/status path.
CONFIG_BT_SCAN_WITH_IDENTITY=n
```

## src/centered_koalagotchi_renderer.c
```c
#include <zephyr/device.h>
#include <zephyr/devicetree.h>
#include <zephyr/drivers/display.h>
#include <zephyr/sys/byteorder.h>
#include <zephyr/sys/util.h>

#include <stdbool.h>
#include <stdint.h>
#include <stddef.h>
#include <string.h>

#define KOALA_TFT_WIDTH 240
#define KOALA_TFT_HEIGHT 135
#define DISPLAY_NODE DT_CHOSEN(zephyr_display)

static const struct device *const koala_display = DEVICE_DT_GET(DISPLAY_NODE);
static uint16_t koala_framebuffer[KOALA_TFT_WIDTH * KOALA_TFT_HEIGHT];

static uint16_t koala_rgb565(uint8_t red, uint8_t green, uint8_t blue)
{
    uint16_t value = (uint16_t)(((red & 0xf8U) << 8) |
                                ((green & 0xfcU) << 3) |
                                (blue >> 3));
    return sys_cpu_to_be16(value);
}

static void koala_pixel(int x, int y, uint16_t color)
{
    if (x < 0 || y < 0 || x >= KOALA_TFT_WIDTH || y >= KOALA_TFT_HEIGHT) {
        return;
    }
    koala_framebuffer[(y * KOALA_TFT_WIDTH) + x] = color;
}

static void koala_fill_rect(int x, int y, int width, int height, uint16_t color)
{
    int x0 = MAX(0, x);
    int y0 = MAX(0, y);
    int x1 = MIN(KOALA_TFT_WIDTH, x + width);
    int y1 = MIN(KOALA_TFT_HEIGHT, y + height);

    for (int row = y0; row < y1; row++) {
        for (int col = x0; col < x1; col++) {
            koala_pixel(col, row, color);
        }
    }
}

static void koala_draw_rect(int x, int y, int width, int height, uint16_t color)
{
    if (width <= 0 || height <= 0) {
        return;
    }
    koala_fill_rect(x, y, width, 1, color);
    koala_fill_rect(x, y + height - 1, width, 1, color);
    koala_fill_rect(x, y, 1, height, color);
    koala_fill_rect(x + width - 1, y, 1, height, color);
}

static void koala_draw_line(int x0, int y0, int x1, int y1, uint16_t color)
{
    int dx = ABS(x1 - x0);
    int sx = x0 < x1 ? 1 : -1;
    int dy = -ABS(y1 - y0);
    int sy = y0 < y1 ? 1 : -1;
    int error = dx + dy;

    while (true) {
        koala_pixel(x0, y0, color);
        if (x0 == x1 && y0 == y1) {
            break;
        }
        int twice = error * 2;
        if (twice >= dy) {
            error += dy;
            x0 += sx;
        }
        if (twice <= dx) {
            error += dx;
            y0 += sy;
        }
    }
}

static void koala_fill_circle(int cx, int cy, int radius, uint16_t color)
{
    int rr = radius * radius;
    for (int y = -radius; y <= radius; y++) {
        for (int x = -radius; x <= radius; x++) {
            if ((x * x) + (y * y) <= rr) {
                koala_pixel(cx + x, cy + y, color);
            }
        }
    }
}

static void koala_draw_circle(int cx, int cy, int radius, uint16_t color)
{
    int x = radius;
    int y = 0;
    int error = 1 - radius;

    while (x >= y) {
        koala_pixel(cx + x, cy + y, color);
        koala_pixel(cx + y, cy + x, color);
        koala_pixel(cx - y, cy + x, color);
        koala_pixel(cx - x, cy + y, color);
        koala_pixel(cx - x, cy - y, color);
        koala_pixel(cx - y, cy - x, color);
        koala_pixel(cx + y, cy - x, color);
        koala_pixel(cx + x, cy - y, color);
        y++;
        if (error < 0) {
            error += (2 * y) + 1;
        } else {
            x--;
            error += (2 * (y - x)) + 1;
        }
    }
}

static void koala_fill_ellipse(int cx, int cy, int rx, int ry, uint16_t color)
{
    if (rx <= 0 || ry <= 0) {
        return;
    }

    int64_t rx2 = (int64_t)rx * rx;
    int64_t ry2 = (int64_t)ry * ry;
    int64_t limit = rx2 * ry2;

    for (int y = -ry; y <= ry; y++) {
        for (int x = -rx; x <= rx; x++) {
            if (((int64_t)x * x * ry2) + ((int64_t)y * y * rx2) <= limit) {
                koala_pixel(cx + x, cy + y, color);
            }
        }
    }
}

static bool koala_glyph(char ch, uint8_t rows[5])
{
    if (ch >= 'a' && ch <= 'z') {
        ch = (char)(ch - 'a' + 'A');
    }

    switch (ch) {
    case 'A': { const uint8_t v[5] = {2, 5, 7, 5, 5}; memcpy(rows, v, 5); return true; }
    case 'B': { const uint8_t v[5] = {6, 5, 6, 5, 6}; memcpy(rows, v, 5); return true; }
    case 'C': { const uint8_t v[5] = {3, 4, 4, 4, 3}; memcpy(rows, v, 5); return true; }
    case 'D': { const uint8_t v[5] = {6, 5, 5, 5, 6}; memcpy(rows, v, 5); return true; }
    case 'E': { const uint8_t v[5] = {7, 4, 6, 4, 7}; memcpy(rows, v, 5); return true; }
    case 'F': { const uint8_t v[5] = {7, 4, 6, 4, 4}; memcpy(rows, v, 5); return true; }
    case 'G': { const uint8_t v[5] = {3, 4, 5, 5, 3}; memcpy(rows, v, 5); return true; }
    case 'H': { const uint8_t v[5] = {5, 5, 7, 5, 5}; memcpy(rows, v, 5); return true; }
    case 'I': { const uint8_t v[5] = {7, 2, 2, 2, 7}; memcpy(rows, v, 5); return true; }
    case 'J': { const uint8_t v[5] = {1, 1, 1, 5, 2}; memcpy(rows, v, 5); return true; }
    case 'K': { const uint8_t v[5] = {5, 5, 6, 5, 5}; memcpy(rows, v, 5); return true; }
    case 'L': { const uint8_t v[5] = {4, 4, 4, 4, 7}; memcpy(rows, v, 5); return true; }
    case 'M': { const uint8_t v[5] = {5, 7, 7, 5, 5}; memcpy(rows, v, 5); return true; }
    case 'N': { const uint8_t v[5] = {5, 7, 7, 7, 5}; memcpy(rows, v, 5); return true; }
    case 'O': { const uint8_t v[5] = {2, 5, 5, 5, 2}; memcpy(rows, v, 5); return true; }
    case 'P': { const uint8_t v[5] = {6, 5, 6, 4, 4}; memcpy(rows, v, 5); return true; }
    case 'Q': { const uint8_t v[5] = {2, 5, 5, 3, 1}; memcpy(rows, v, 5); return true; }
    case 'R': { const uint8_t v[5] = {6, 5, 6, 5, 5}; memcpy(rows, v, 5); return true; }
    case 'S': { const uint8_t v[5] = {3, 4, 2, 1, 6}; memcpy(rows, v, 5); return true; }
    case 'T': { const uint8_t v[5] = {7, 2, 2, 2, 2}; memcpy(rows, v, 5); return true; }
    case 'U': { const uint8_t v[5] = {5, 5, 5, 5, 7}; memcpy(rows, v, 5); return true; }
    case 'V': { const uint8_t v[5] = {5, 5, 5, 5, 2}; memcpy(rows, v, 5); return true; }
    case 'W': { const uint8_t v[5] = {5, 5, 7, 7, 5}; memcpy(rows, v, 5); return true; }
    case 'X': { const uint8_t v[5] = {5, 5, 2, 5, 5}; memcpy(rows, v, 5); return true; }
    case 'Y': { const uint8_t v[5] = {5, 5, 2, 2, 2}; memcpy(rows, v, 5); return true; }
    case 'Z': { const uint8_t v[5] = {7, 1, 2, 4, 7}; memcpy(rows, v, 5); return true; }
    case '0': { const uint8_t v[5] = {7, 5, 5, 5, 7}; memcpy(rows, v, 5); return true; }
    case '1': { const uint8_t v[5] = {2, 6, 2, 2, 7}; memcpy(rows, v, 5); return true; }
    case '2': { const uint8_t v[5] = {6, 1, 2, 4, 7}; memcpy(rows, v, 5); return true; }
    case '3': { const uint8_t v[5] = {6, 1, 2, 1, 6}; memcpy(rows, v, 5); return true; }
    case '4': { const uint8_t v[5] = {5, 5, 7, 1, 1}; memcpy(rows, v, 5); return true; }
    case '5': { const uint8_t v[5] = {7, 4, 6, 1, 6}; memcpy(rows, v, 5); return true; }
    case '6': { const uint8_t v[5] = {3, 4, 6, 5, 2}; memcpy(rows, v, 5); return true; }
    case '7': { const uint8_t v[5] = {7, 1, 2, 2, 2}; memcpy(rows, v, 5); return true; }
    case '8': { const uint8_t v[5] = {2, 5, 2, 5, 2}; memcpy(rows, v, 5); return true; }
    case '9': { const uint8_t v[5] = {2, 5, 3, 1, 6}; memcpy(rows, v, 5); return true; }
    case '-': { const uint8_t v[5] = {0, 0, 7, 0, 0}; memcpy(rows, v, 5); return true; }
    case '_': { const uint8_t v[5] = {0, 0, 0, 0, 7}; memcpy(rows, v, 5); return true; }
    case '/': { const uint8_t v[5] = {1, 1, 2, 4, 4}; memcpy(rows, v, 5); return true; }
    case ':': { const uint8_t v[5] = {0, 2, 0, 2, 0}; memcpy(rows, v, 5); return true; }
    case '+': { const uint8_t v[5] = {0, 2, 7, 2, 0}; memcpy(rows, v, 5); return true; }
    case '.': { const uint8_t v[5] = {0, 0, 0, 0, 2}; memcpy(rows, v, 5); return true; }
    case ' ': memset(rows, 0, 5); return true;
    default: { const uint8_t v[5] = {7, 1, 2, 0, 2}; memcpy(rows, v, 5); return false; }
    }
}

static void koala_draw_char(int x, int y, char ch, uint16_t color, int scale)
{
    uint8_t rows[5];
    (void)koala_glyph(ch, rows);
    scale = MAX(1, scale);

    for (int row = 0; row < 5; row++) {
        for (int col = 0; col < 3; col++) {
            if (rows[row] & (1U << (2 - col))) {
                koala_fill_rect(x + (col * scale), y + (row * scale),
                                scale, scale, color);
            }
        }
    }
}

static void koala_draw_text(int x, int y, const char *text, uint16_t color,
                            int scale, int max_chars)
{
    if (!text || max_chars <= 0) {
        return;
    }

    int cursor = x;
    int advance = (4 * MAX(1, scale));
    for (int i = 0; text[i] && i < max_chars; i++) {
        koala_draw_char(cursor, y, text[i], color, scale);
        cursor += advance;
        if (cursor >= KOALA_TFT_WIDTH - 2) {
            break;
        }
    }
}

static void koala_draw_panel(int x, int y, int width, int height,
                             uint16_t fill, uint16_t edge)
{
    koala_fill_rect(x, y, width, height, fill);
    koala_draw_rect(x, y, width, height, edge);
    if (width > 8 && height > 8) {
        koala_pixel(x + 2, y + 2, edge);
        koala_pixel(x + width - 3, y + 2, edge);
        koala_pixel(x + 2, y + height - 3, edge);
        koala_pixel(x + width - 3, y + height - 3, edge);
    }
}

static void koala_draw_bar(int x, int y, int width, int height, int percent,
                           uint16_t fill, uint16_t track, uint16_t edge)
{
    percent = CLAMP(percent, 0, 100);
    koala_fill_rect(x, y, width, height, track);
    koala_draw_rect(x, y, width, height, edge);
    int inner = MAX(0, width - 2);
    int active = (inner * percent) / 100;
    if (active > 0 && height > 2) {
        koala_fill_rect(x + 1, y + 1, active, height - 2, fill);
    }
}

static void koala_draw_leaf(int cx, int cy, uint16_t fill, uint16_t edge,
                            bool lean_right)
{
    for (int x = -6; x <= 6; x++) {
        int half = 3 - (ABS(x) / 3);
        half = MAX(1, half);
        int skew = lean_right ? (x / 4) : -(x / 4);
        koala_fill_rect(cx + x, cy + skew - half, 1, (half * 2) + 1, fill);
    }
    koala_draw_line(cx - 6, cy + (lean_right ? -1 : 1),
                    cx + 6, cy + (lean_right ? 1 : -1), edge);
}

static void koala_draw_eye(int cx, int cy, uint16_t iris, bool blink,
                           int pupil_offset)
{
    const uint16_t white = koala_rgb565(226, 234, 238);
    const uint16_t black = koala_rgb565(2, 4, 6);

    if (blink) {
        koala_draw_line(cx - 7, cy, cx + 7, cy, iris);
        return;
    }

    koala_fill_ellipse(cx, cy, 8, 6, white);
    koala_fill_circle(cx + pupil_offset, cy, 4, iris);
    koala_fill_circle(cx + pupil_offset, cy, 2, black);
    koala_pixel(cx + pupil_offset - 1, cy - 2, white);
}

static bool koala_contains_ci(const char *text, const char *needle)
{
    if (!text || !needle || !needle[0]) {
        return false;
    }

    size_t needle_len = strlen(needle);
    for (size_t i = 0; text[i]; i++) {
        size_t j = 0;
        while (j < needle_len && text[i + j]) {
            char a = text[i + j];
            char b = needle[j];
            if (a >= 'a' && a <= 'z') a = (char)(a - 'a' + 'A');
            if (b >= 'a' && b <= 'z') b = (char)(b - 'a' + 'A');
            if (a != b) {
                break;
            }
            j++;
        }
        if (j == needle_len) {
            return true;
        }
    }
    return false;
}

static int koala_active_footer_key(const char *action_title)
{
    if (koala_contains_ci(action_title, "SCAN")) return 0;
    if (koala_contains_ci(action_title, "PET")) return 1;
    if (koala_contains_ci(action_title, "EUC")) return 2;
    if (koala_contains_ci(action_title, "BOOM")) return 3;
    if (koala_contains_ci(action_title, "LOG")) return 4;
    if (koala_contains_ci(action_title, "BACK")) return 5;
    return 2;
}

static void koala_draw_action_title(int x, int y, const char *action_title,
                                    uint16_t color)
{
    char title[18];
    const char *source = (action_title && action_title[0]) ? action_title : "EUCALYPTUS";
    int out = 0;

    for (int i = 0; source[i] && out < (int)sizeof(title) - 1; i++) {
        char ch = source[i];
        if (ch >= 'a' && ch <= 'z') {
            ch = (char)(ch - 'a' + 'A');
        }
        if ((ch >= 'A' && ch <= 'Z') || (ch >= '0' && ch <= '9')) {
            title[out++] = ch;
        } else if (ch == '-' || ch == '_' || ch == ' ') {
            if (out > 0 && title[out - 1] != ' ') {
                title[out++] = ' ';
            }
        }
    }
    title[out] = '\0';

    if (out == 0) {
        memcpy(title, "EUCALYPTUS", sizeof("EUCALYPTUS"));
    }
    koala_draw_text(x, y, title, color, 1, 17);
}

static void koala_draw_koala(int cx, int cy, uint8_t phase,
                             uint16_t purple, uint16_t green,
                             uint16_t hud_green)
{
    const uint16_t fur = koala_rgb565(157, 166, 174);
    const uint16_t fur_dark = koala_rgb565(91, 101, 111);
    const uint16_t fur_light = koala_rgb565(215, 222, 226);
    const uint16_t black = koala_rgb565(2, 4, 6);
    const uint16_t cyan = koala_rgb565(89, 219, 226);

    static const int8_t bob[8] = {0, -1, -1, 0, 0, 1, 1, 0};
    int yoff = bob[phase & 7U];
    bool blink = (phase == 5U || phase == 6U);
    int pupil = (phase < 4U) ? -1 : ((phase < 8U) ? 0 : 1);

    koala_fill_circle(cx - 23, cy - 20 + yoff, 12, fur_dark);
    koala_fill_circle(cx + 23, cy - 20 + yoff, 12, fur_dark);
    koala_fill_circle(cx - 23, cy - 20 + yoff, 7, fur_light);
    koala_fill_circle(cx + 23, cy - 20 + yoff, 7, fur_light);

    koala_fill_ellipse(cx, cy - 6 + yoff, 28, 25, fur);
    koala_fill_ellipse(cx, cy + 2 + yoff, 21, 15, fur_light);

    koala_draw_line(cx - 16, cy - 15 + yoff,
                    cx - 7, cy - 18 + yoff, black);
    koala_draw_line(cx + 7, cy - 18 + yoff,
                    cx + 16, cy - 15 + yoff, black);

    koala_draw_eye(cx - 10, cy - 7 + yoff, purple, blink, pupil);
    koala_draw_eye(cx + 10, cy - 7 + yoff, green, blink, pupil);

    koala_fill_ellipse(cx, cy + 4 + yoff, 6, 5, black);
    koala_draw_line(cx, cy + 8 + yoff, cx, cy + 12 + yoff, black);
    koala_draw_line(cx, cy + 12 + yoff, cx - 6, cy + 15 + yoff, black);
    koala_draw_line(cx, cy + 12 + yoff, cx + 6, cy + 15 + yoff, black);

    koala_fill_ellipse(cx, cy + 29 + yoff, 19, 18, fur_dark);
    koala_fill_ellipse(cx, cy + 32 + yoff, 11, 13, fur_light);
    koala_fill_circle(cx - 19, cy + 25 + yoff, 7, fur);
    koala_fill_circle(cx + 19, cy + 25 + yoff, 7, fur);

    koala_fill_rect(cx - 10, cy + 17 + yoff, 20, 7, black);
    koala_draw_rect(cx - 10, cy + 17 + yoff, 20, 7, cyan);
    koala_draw_text(cx - 4, cy + 18 + yoff, "KB", hud_green, 1, 2);
}

static void koala_draw_footer(const char *action_title, uint16_t panel,
                              uint16_t edge, uint16_t green, uint16_t yellow,
                              uint16_t white)
{
    static const char *keys[6] = {"F1", "F2", "F3", "F4", "F5", "F6"};
    static const char *labels[6] = {"S", "P", "E", "B", "L", "K"};
    int active = koala_active_footer_key(action_title);

    koala_draw_panel(5, 114, 230, 17, panel, edge);
    for (int i = 0; i < 6; i++) {
        int x = 9 + (i * 38);
        uint16_t button_fill = (i == active) ? koala_rgb565(30, 65, 36) : panel;
        uint16_t button_edge = (i == active) ? green : edge;
        koala_fill_rect(x, 117, 33, 11, button_fill);
        koala_draw_rect(x, 117, 33, 11, button_edge);
        koala_draw_text(x + 3, 120, keys[i], yellow, 1, 2);
        koala_draw_text(x + 20, 120, labels[i], white, 1, 1);
    }
}

static void koala_flush(void)
{
    if (!device_is_ready(koala_display)) {
        return;
    }

    const struct display_buffer_descriptor descriptor = {
        .buf_size = sizeof(koala_framebuffer),
        .width = KOALA_TFT_WIDTH,
        .height = KOALA_TFT_HEIGHT,
        .pitch = KOALA_TFT_WIDTH,
    };
    (void)display_write(koala_display, 0, 0, &descriptor, koala_framebuffer);
}

void koala_centered_render_koalagotchi_action(const char *action_title,
                                               uint8_t frame_index)
{
    const uint16_t background = koala_rgb565(2, 8, 10);
    const uint16_t panel = koala_rgb565(5, 18, 23);
    const uint16_t panel_alt = koala_rgb565(7, 25, 27);
    const uint16_t green = koala_rgb565(54, 255, 118);
    const uint16_t green_dim = koala_rgb565(22, 111, 65);
    const uint16_t cyan = koala_rgb565(91, 218, 225);
    const uint16_t yellow = koala_rgb565(255, 225, 94);
    const uint16_t purple = koala_rgb565(170, 72, 255);
    const uint16_t white = koala_rgb565(222, 230, 233);
    const uint16_t black = koala_rgb565(2, 4, 6);

    uint8_t phase = frame_index & 15U;
    int pulse = (phase < 8U) ? phase : (15 - phase);

    for (size_t index = 0; index < ARRAY_SIZE(koala_framebuffer); index++) {
        koala_framebuffer[index] = background;
    }

    /* Canonical cyber-jungle HUD frame. Koalagotchi stays fixed at center;
     * only eyes, breathing, radar, leaves, and telemetry pulse. */
    koala_draw_rect(1, 1, 238, 132, green);
    koala_draw_rect(3, 3, 234, 128, green_dim);

    koala_draw_panel(6, 5, 228, 11, panel, green_dim);
    koala_draw_text(10, 8, "KILLERKOALA//KOALAGOTCHI", cyan, 1, 26);
    koala_draw_text(132, 8, "LV18", yellow, 1, 4);
    koala_draw_text(153, 8, "SAFE", green, 1, 4);
    koala_draw_rect(207, 7, 22, 7, white);
    koala_fill_rect(209, 9, 13 + (pulse / 3), 3, green);
    koala_fill_rect(229, 9, 3, 3, white);

    /* Left telemetry stack. */
    koala_draw_panel(6, 20, 52, 23, panel, green_dim);
    koala_draw_text(10, 23, "MOOD", white, 1, 4);
    koala_draw_text(10, 31, "CALM", green, 1, 4);
    koala_draw_bar(34, 31, 19, 5, 72 + pulse, green, black, green_dim);

    koala_draw_panel(6, 47, 52, 23, panel, green_dim);
    koala_draw_text(10, 50, "SIG", white, 1, 3);
    koala_draw_text(10, 58, "BLE", cyan, 1, 3);
    koala_draw_text(37, 58, "03", green, 1, 2);

    koala_draw_panel(6, 74, 52, 35, panel, green_dim);
    koala_draw_text(10, 77, "KOALA", white, 1, 5);
    koala_draw_text(10, 86, "+WATCH", green, 1, 6);
    koala_draw_text(10, 94, "+CLEAN", green, 1, 6);
    koala_draw_text(10, 102, "+XP", yellow, 1, 3);

    /* Right telemetry stack. */
    koala_draw_panel(182, 20, 52, 23, panel, green_dim);
    koala_draw_text(186, 23, "NOISE", white, 1, 5);
    koala_draw_bar(186, 32, 42, 5, 31 + (pulse * 2), green, black, green_dim);

    koala_draw_panel(182, 47, 52, 23, panel, green_dim);
    koala_draw_text(186, 50, "AURA", white, 1, 4);
    koala_draw_text(186, 59, "ON", green, 1, 2);
    koala_draw_bar(203, 59, 25, 5, 83, cyan, black, green_dim);

    koala_draw_panel(182, 74, 52, 35, panel, green_dim);
    koala_draw_text(186, 77, "BLOCK", white, 1, 5);
    koala_draw_text(216, 77, "03", green, 1, 2);
    koala_draw_text(186, 86, "XP", white, 1, 2);
    koala_draw_bar(199, 86, 29, 5, 88, yellow, black, green_dim);
    koala_draw_text(186, 96, "DEF", white, 1, 3);
    koala_draw_text(207, 96, "ON", green, 1, 2);

    /* Center mode card and radar field. */
    koala_draw_panel(64, 20, 112, 18, panel_alt, green);
    koala_draw_text(68, 23, "MODE", white, 1, 4);
    koala_draw_action_title(88, 23, action_title, green);
    koala_draw_text(68, 31, "DEFENSE AURA", cyan, 1, 12);

    int radar_radius = 28 + (pulse / 2);
    koala_draw_circle(120, 67, radar_radius, green_dim);
    koala_draw_circle(120, 67, 38, green_dim);
    koala_draw_circle(120, 67, 48, koala_rgb565(11, 64, 45));
    koala_draw_line(120, 40, 120, 96, koala_rgb565(12, 75, 49));
    koala_draw_line(75, 67, 165, 67, koala_rgb565(12, 75, 49));
    koala_draw_line(120, 67, 147 + (pulse / 2), 50 - (pulse / 3), green);
    koala_fill_circle(120, 67, 2, green);

    koala_draw_leaf(72 + (phase & 1U), 51, green, cyan, true);
    koala_draw_leaf(169 - (phase & 1U), 49, green, cyan, false);
    koala_draw_leaf(74, 87 + (phase & 1U), green_dim, green, false);
    koala_draw_leaf(167, 89 - (phase & 1U), green_dim, green, true);

    koala_draw_koala(120, 66, phase, purple, green, cyan);

    koala_draw_panel(65, 96, 110, 13, panel, green);
    koala_draw_text(69, 100, "KOALA ONLINE", white, 1, 12);
    koala_fill_rect(160, 100, 7, 5, green_dim);
    koala_fill_rect(161, 101, 3 + (pulse / 3), 3, green);

    koala_draw_footer(action_title, panel, green_dim, green, yellow, white);

    koala_flush();
}
```

## src/display_power_init.c
```c
#include <zephyr/device.h>
#include <zephyr/devicetree.h>
#include <zephyr/drivers/gpio.h>
#include <zephyr/init.h>

#include <errno.h>

/*
 * NCS v2.9 predates the upstream Heltec T114 v2 devicetree model.  Its GPIO
 * macros cannot safely consume the board_controls child aliases from the
 * backported board definition, even though the underlying nRF52840 GPIO pins
 * are stable.  Drive the three documented T114 v2 control pins directly so
 * display power is ready before the ST7789 driver probes the panel.
 *
 * Upstream board mapping:
 *   P0.21 VEXT control       active high
 *   P0.03 TFT enable        active low
 *   P0.15 TFT backlight     active low
 */
#define KOALABYTE_GPIO0_NODE DT_NODELABEL(gpio0)
#define KOALABYTE_VEXT_CONTROL_PIN 21
#define KOALABYTE_TFT_ENABLE_PIN 3
#define KOALABYTE_TFT_BACKLIGHT_PIN 15

static const struct device *const koalabyte_gpio0 =
    DEVICE_DT_GET(KOALABYTE_GPIO0_NODE);

static int configure_output(unsigned int pin, int physical_level)
{
    int rc;

    if (!device_is_ready(koalabyte_gpio0)) {
        return -ENODEV;
    }

    rc = gpio_pin_configure(koalabyte_gpio0, pin, GPIO_OUTPUT);
    if (rc != 0) {
        return rc;
    }

    return gpio_pin_set(koalabyte_gpio0, pin, physical_level);
}

static int koalabyte_t114_display_power_init(void)
{
    int rc;

    rc = configure_output(KOALABYTE_VEXT_CONTROL_PIN, 1);
    if (rc != 0) {
        return rc;
    }

    rc = configure_output(KOALABYTE_TFT_ENABLE_PIN, 0);
    if (rc != 0) {
        return rc;
    }

    return configure_output(KOALABYTE_TFT_BACKLIGHT_PIN, 0);
}

/*
 * The ST7789 display driver initializes at CONFIG_DISPLAY_INIT_PRIORITY (85).
 * Run after GPIO devices are ready but before the display driver probes the
 * panel.  Keep the legacy marker names for the no-hardware readiness gate:
 * vext_control, tft_enable, tft_backlight.
 */
SYS_INIT(koalabyte_t114_display_power_init, POST_KERNEL, 70);
```

## src/error_alarm_wrapper.c
```c
#include <zephyr/device.h>
#include <zephyr/devicetree.h>
#include <zephyr/drivers/display.h>
#include <zephyr/kernel.h>
#include <zephyr/sys/byteorder.h>
#include <zephyr/sys/util.h>

#include <stdbool.h>
#include <stdint.h>
#include <stdio.h>
#include <string.h>

#include "loading_display.h"

/*
 * Runtime display layer for the Heltec T114.
 *
 * The supplied cyber-mouth artwork remains the full-screen base image. Only the
 * muzzle/mouth region is redrawn procedurally, preserving the existing design
 * while replacing full-frame picture swaps with continuous geometry changes.
 * Menu and action states use the existing Koalagotchi renderer and are animated
 * locally until the Pi/ESP32 returns the display to the mouth state.
 */

#define PROC_X 20
#define PROC_Y 35
#define PROC_W 200
#define PROC_H 88
#define KOALA_ANIMATION_MS 95
#define KOALA_ERROR_ALARM_MS 180

#define DISPLAY_NODE DT_CHOSEN(zephyr_display)
static const struct device *const procedural_display = DEVICE_DT_GET(DISPLAY_NODE);
static uint16_t procedural_frame[PROC_W * PROC_H];

struct mouth_pose {
    int jaw;
    int curl;
    int asymmetry;
    int snarl;
    int teeth;
    int tongue;
};

enum procedural_mode {
    PROC_MODE_MOUTH = 0,
    PROC_MODE_MENU_KOALAGOTCHI,
    PROC_MODE_ACTION_KOALAGOTCHI,
    PROC_MODE_ERROR,
};

static K_MUTEX_DEFINE(procedural_render_mutex);
static enum procedural_mode procedural_mode = PROC_MODE_MOUTH;
static bool base_art_dirty = true;
static bool error_banner_phase;
static char active_message[96] = "KILLERKOALA";
static uint8_t active_from_frame;
static uint8_t active_to_frame;
static uint8_t active_blend;
static uint8_t koalagotchi_frame;

void __real_render_killerkoala_mouth(const char *state, const char *message,
                                     uint8_t from_frame_index,
                                     uint8_t to_frame_index,
                                     uint8_t blend_amount);
void __real_render_menu_status(const char *message);
void __real_render_koalagotchi_action(const char *action_title,
                                      uint8_t frame_index);

static uint16_t rgb565_be(uint8_t red, uint8_t green, uint8_t blue)
{
    uint16_t value = (uint16_t)(((red & 0xf8U) << 8) |
                                ((green & 0xfcU) << 3) |
                                (blue >> 3));
    return sys_cpu_to_be16(value);
}

static void proc_set_pixel(int x, int y, uint16_t color)
{
    if (x < 0 || y < 0 || x >= PROC_W || y >= PROC_H) {
        return;
    }
    procedural_frame[(y * PROC_W) + x] = color;
}

static void proc_fill_rect(int x, int y, int width, int height, uint16_t color)
{
    int x0 = MAX(x, 0);
    int y0 = MAX(y, 0);
    int x1 = MIN(x + width, PROC_W);
    int y1 = MIN(y + height, PROC_H);
    for (int row = y0; row < y1; row++) {
        for (int col = x0; col < x1; col++) {
            proc_set_pixel(col, row, color);
        }
    }
}

static void proc_fill_ellipse(int cx, int cy, int rx, int ry, uint16_t color)
{
    if (rx <= 0 || ry <= 0) {
        return;
    }
    int64_t rx2 = (int64_t)rx * rx;
    int64_t ry2 = (int64_t)ry * ry;
    int64_t limit = rx2 * ry2;
    for (int y = -ry; y <= ry; y++) {
        int64_t y_term = (int64_t)y * y * rx2;
        for (int x = -rx; x <= rx; x++) {
            if (((int64_t)x * x * ry2) + y_term <= limit) {
                proc_set_pixel(cx + x, cy + y, color);
            }
        }
    }
}

static void proc_draw_line(int x0, int y0, int x1, int y1, int thickness,
                           uint16_t color)
{
    int dx = abs(x1 - x0);
    int sx = x0 < x1 ? 1 : -1;
    int dy = -abs(y1 - y0);
    int sy = y0 < y1 ? 1 : -1;
    int err = dx + dy;
    for (;;) {
        proc_fill_ellipse(x0, y0, MAX(1, thickness), MAX(1, thickness), color);
        if (x0 == x1 && y0 == y1) {
            break;
        }
        int twice = err * 2;
        if (twice >= dy) {
            err += dy;
            x0 += sx;
        }
        if (twice <= dx) {
            err += dx;
            y0 += sy;
        }
    }
}

static void proc_draw_quadratic(int x0, int y0, int cx, int cy,
                                int x1, int y1, int thickness,
                                uint16_t color)
{
    int previous_x = x0;
    int previous_y = y0;
    for (int step = 1; step <= 24; step++) {
        int t = (step * 256) / 24;
        int inverse = 256 - t;
        int x = (inverse * inverse * x0 +
                 2 * inverse * t * cx + t * t * x1) >> 16;
        int y = (inverse * inverse * y0 +
                 2 * inverse * t * cy + t * t * y1) >> 16;
        proc_draw_line(previous_x, previous_y, x, y, thickness, color);
        previous_x = x;
        previous_y = y;
    }
}

static void proc_fill_tooth(int center_x, int top_y, int width, int height,
                            bool points_down, uint16_t color)
{
    for (int row = 0; row < height; row++) {
        int taper = (row * width) / MAX(height, 1);
        int half = MAX(1, (width - taper) / 2);
        int y = points_down ? top_y + row : top_y - row;
        proc_fill_rect(center_x - half, y, half * 2 + 1, 1, color);
    }
}

static int lerp_int(int from, int to, uint8_t amount)
{
    return from + (((to - from) * (int)amount) / 255);
}

static struct mouth_pose pose_for_frame(uint8_t frame)
{
    switch (frame) {
    case 1: /* happy */
        return (struct mouth_pose){82, 92, 0, 0, 118, 72};
    case 2: /* bite */
        return (struct mouth_pose){126, 18, 0, 42, 198, 22};
    case 3: /* snarl */
        return (struct mouth_pose){88, -58, 18, 235, 238, 0};
    case 4: /* sideways grin */
        return (struct mouth_pose){48, 48, 104, 34, 142, 26};
    default: /* smile */
        return (struct mouth_pose){32, 64, 0, 0, 78, 30};
    }
}

static struct mouth_pose blended_pose(uint8_t from_frame, uint8_t to_frame,
                                      uint8_t blend)
{
    struct mouth_pose from = pose_for_frame(from_frame);
    struct mouth_pose to = pose_for_frame(to_frame);
    return (struct mouth_pose){
        lerp_int(from.jaw, to.jaw, blend),
        lerp_int(from.curl, to.curl, blend),
        lerp_int(from.asymmetry, to.asymmetry, blend),
        lerp_int(from.snarl, to.snarl, blend),
        lerp_int(from.teeth, to.teeth, blend),
        lerp_int(from.tongue, to.tongue, blend),
    };
}

static int triangle_wave(int64_t time_ms, int period_ms, int amplitude)
{
    int phase = (int)(time_ms % period_ms);
    int half = period_ms / 2;
    int value = phase <= half ? phase : period_ms - phase;
    return (value * amplitude) / MAX(half, 1);
}

static void draw_procedural_mouth_locked(const char *state,
                                         uint8_t from_frame,
                                         uint8_t to_frame,
                                         uint8_t blend)
{
    const uint16_t deep = rgb565_be(3, 5, 8);
    const uint16_t muzzle = rgb565_be(34, 38, 43);
    const uint16_t muzzle_light = rgb565_be(66, 72, 78);
    const uint16_t cavity = rgb565_be(7, 2, 8);
    const uint16_t gum = rgb565_be(86, 15, 42);
    const uint16_t tooth = rgb565_be(236, 240, 225);
    const uint16_t tooth_shadow = rgb565_be(132, 143, 137);
    const uint16_t tongue = rgb565_be(183, 48, 92);
    const uint16_t purple = rgb565_be(177, 71, 255);
    const uint16_t purple_dim = rgb565_be(72, 29, 105);
    const uint16_t green = rgb565_be(70, 255, 112);
    const uint16_t green_dim = rgb565_be(22, 94, 45);
    const uint16_t black = rgb565_be(0, 0, 0);

    struct mouth_pose pose = blended_pose(from_frame, to_frame, blend);
    int64_t now = k_uptime_get();
    bool speaking = state && strcmp(state, "speaking") == 0;
    bool thinking = state && (strcmp(state, "thinking") == 0 ||
                              strcmp(state, "wake") == 0);

    if (speaking) {
        pose.jaw = MIN(230, pose.jaw + triangle_wave(now, 310, 100));
        pose.asymmetry += triangle_wave(now + 80, 720, 22) - 11;
        pose.tongue = MAX(pose.tongue, 42);
    } else {
        pose.jaw = MIN(230, pose.jaw + triangle_wave(now, 3200, 8));
    }
    if (thinking) {
        pose.asymmetry += triangle_wave(now, 1500, 34) - 17;
    }
    if (state && strcmp(state, "error") == 0) {
        pose.snarl = 255;
        pose.teeth = 255;
        pose.curl = -70;
        pose.jaw = MAX(pose.jaw, 96);
    }

    for (int y = 0; y < PROC_H; y++) {
        uint8_t shade = (uint8_t)(5 + ((y * 14) / PROC_H));
        uint16_t background = rgb565_be(shade, shade + 2, shade + 5);
        proc_fill_rect(0, y, PROC_W, 1, background);
    }

    /* Keep the broad cyber-koala muzzle silhouette from the current artwork. */
    proc_fill_ellipse(100, 47, 94, 42, muzzle);
    proc_fill_ellipse(52, 42, 43, 34, muzzle_light);
    proc_fill_ellipse(148, 42, 43, 34, muzzle_light);
    proc_fill_ellipse(100, 31, 72, 25, muzzle);
    proc_fill_rect(8, 65, 184, 18, deep);

    /* Purple-left and lime-right illumination preserve the existing design. */
    proc_draw_quadratic(13, 61, 24, 14, 84, 18, 3, purple_dim);
    proc_draw_quadratic(187, 61, 176, 14, 116, 18, 3, green_dim);
    proc_draw_line(10, 73, 74, 80, 2, purple);
    proc_draw_line(190, 73, 126, 80, 2, green);

    int jaw_height = 10 + ((pose.jaw * 25) / 255);
    int left_corner = 28 + (pose.asymmetry / 7);
    int right_corner = 172 + (pose.asymmetry / 12);
    int upper_center = 41 - (pose.curl / 18);
    int lower_center = 48 + jaw_height + (pose.curl / 22);

    proc_fill_ellipse(100 + (pose.asymmetry / 18), 48 + jaw_height / 2,
                      72, jaw_height + 7, cavity);
    if (pose.snarl > 80) {
        proc_fill_ellipse(100, 45, 68, 10 + (pose.snarl / 32), gum);
    }

    /* Tongue is geometry, not another image frame. */
    if (pose.tongue > 20 && jaw_height > 15) {
        int tongue_y = 55 + jaw_height / 2;
        int tongue_rx = 26 + pose.tongue / 10;
        int tongue_ry = 4 + pose.tongue / 22;
        proc_fill_ellipse(103 + pose.asymmetry / 24, tongue_y,
                          tongue_rx, tongue_ry, tongue);
        proc_draw_line(103, tongue_y - tongue_ry + 1,
                       103, tongue_y + tongue_ry - 2, 1,
                       rgb565_be(110, 24, 60));
    }

    int tooth_count = 5 + (pose.teeth / 62);
    int spacing = 108 / MAX(tooth_count - 1, 1);
    int tooth_height = 5 + pose.teeth / 30;
    for (int index = 0; index < tooth_count; index++) {
        int x = 46 + index * spacing + ((index & 1) ? pose.asymmetry / 40 : 0);
        proc_fill_tooth(x + 1, 47, 10, tooth_height, true, tooth_shadow);
        proc_fill_tooth(x, 46, 9, tooth_height, true, tooth);
        if (jaw_height > 20 && pose.teeth > 105) {
            proc_fill_tooth(x + spacing / 2, 55 + jaw_height,
                            8, MAX(4, tooth_height - 2), false, tooth);
        }
    }

    /* Continuously deform the same upper and lower cyber lips. */
    proc_draw_quadratic(left_corner, 49,
                        66 + pose.asymmetry / 18, upper_center,
                        100, 46 - pose.curl / 26,
                        3, purple);
    proc_draw_quadratic(100, 46 - pose.curl / 26,
                        136 + pose.asymmetry / 22, upper_center,
                        right_corner, 49,
                        3, green);
    proc_draw_quadratic(left_corner, 50,
                        66 + pose.asymmetry / 20, lower_center,
                        100, 55 + jaw_height,
                        3, purple);
    proc_draw_quadratic(100, 55 + jaw_height,
                        136 + pose.asymmetry / 18, lower_center,
                        right_corner, 50,
                        3, green);

    /* Dark lip core and neon specular marks retain the original aggressive look. */
    proc_draw_quadratic(left_corner + 3, 50, 70, 48, 100, 49, 1, black);
    proc_draw_quadratic(100, 49, 132, 48, right_corner - 3, 50, 1, black);
    proc_draw_line(35, 42, 61, 31 - pose.snarl / 30, 2, purple);
    proc_draw_line(165, 42, 139, 31 - pose.snarl / 30, 2, green);
    proc_fill_ellipse(48, 27, 3, 2, purple);
    proc_fill_ellipse(152, 27, 3, 2, green);

    const struct display_buffer_descriptor descriptor = {
        .buf_size = sizeof(procedural_frame),
        .width = PROC_W,
        .height = PROC_H,
        .pitch = PROC_W,
    };
    if (device_is_ready(procedural_display)) {
        (void)display_write(procedural_display, PROC_X, PROC_Y,
                            &descriptor, procedural_frame);
    }
}

static void ensure_base_art_locked(void)
{
    if (!base_art_dirty) {
        return;
    }
    __real_render_killerkoala_mouth("idle", "KILLERKOALA", 0, 0, 0);
    base_art_dirty = false;
}

static void procedural_work_handler(struct k_work *work);
K_WORK_DELAYABLE_DEFINE(procedural_work, procedural_work_handler);

static void procedural_work_handler(struct k_work *work)
{
    ARG_UNUSED(work);
    int delay_ms = 0;

    k_mutex_lock(&procedural_render_mutex, K_FOREVER);
    if (procedural_mode == PROC_MODE_MENU_KOALAGOTCHI ||
        procedural_mode == PROC_MODE_ACTION_KOALAGOTCHI) {
        koalagotchi_frame = (uint8_t)((koalagotchi_frame + 1U) % 8U);
        __real_render_koalagotchi_action(active_message, koalagotchi_frame);
        base_art_dirty = true;
        delay_ms = KOALA_ANIMATION_MS;
    } else if (procedural_mode == PROC_MODE_ERROR) {
        error_banner_phase = !error_banner_phase;
        if (error_banner_phase) {
            __real_render_menu_status("ERROR");
            base_art_dirty = true;
        } else {
            ensure_base_art_locked();
            draw_procedural_mouth_locked("error", active_from_frame,
                                         active_to_frame, active_blend);
        }
        delay_ms = KOALA_ERROR_ALARM_MS;
    }
    k_mutex_unlock(&procedural_render_mutex);

    if (delay_ms > 0) {
        (void)k_work_reschedule(&procedural_work, K_MSEC(delay_ms));
    }
}

static void activate_koalagotchi(enum procedural_mode mode,
                                 const char *message, uint8_t first_frame)
{
    k_mutex_lock(&procedural_render_mutex, K_FOREVER);
    procedural_mode = mode;
    snprintf(active_message, sizeof(active_message), "%s",
             message && message[0] ? message :
             (mode == PROC_MODE_MENU_KOALAGOTCHI ? "MENU" : "PLAYING"));
    koalagotchi_frame = first_frame % 8U;
    error_banner_phase = false;
    __real_render_koalagotchi_action(active_message, koalagotchi_frame);
    base_art_dirty = true;
    k_mutex_unlock(&procedural_render_mutex);
    (void)k_work_reschedule(&procedural_work, K_MSEC(KOALA_ANIMATION_MS));
}

void __wrap_render_menu_status(const char *message)
{
    activate_koalagotchi(PROC_MODE_MENU_KOALAGOTCHI,
                         message && message[0] ? message : "MENU", 0);
}

void __wrap_render_koalagotchi_action(const char *action_title,
                                      uint8_t frame_index)
{
    activate_koalagotchi(PROC_MODE_ACTION_KOALAGOTCHI,
                         action_title && action_title[0] ? action_title : "PLAYING",
                         frame_index);
}

void __wrap_render_killerkoala_mouth(const char *state, const char *message,
                                     uint8_t from_frame_index,
                                     uint8_t to_frame_index,
                                     uint8_t blend_amount)
{
    const char *resolved_state = state && state[0] ? state : "idle";

    if (!strcmp(resolved_state, "menu") ||
        !strcmp(resolved_state, "menu_highlight") ||
        !strcmp(resolved_state, "menu_select")) {
        activate_koalagotchi(PROC_MODE_MENU_KOALAGOTCHI, message, 0);
        return;
    }
    if (!strcmp(resolved_state, "action") ||
        !strcmp(resolved_state, "koalagotchi_action")) {
        activate_koalagotchi(PROC_MODE_ACTION_KOALAGOTCHI, message, 0);
        return;
    }

    bool is_error = strcmp(resolved_state, "error") == 0;
    k_mutex_lock(&procedural_render_mutex, K_FOREVER);
    procedural_mode = is_error ? PROC_MODE_ERROR : PROC_MODE_MOUTH;
    error_banner_phase = false;
    active_from_frame = from_frame_index;
    active_to_frame = to_frame_index;
    active_blend = blend_amount;
    snprintf(active_message, sizeof(active_message), "%s",
             message && message[0] ? message :
             (is_error ? "ERROR" : "KILLERKOALA"));

    if (!is_error) {
        (void)k_work_cancel_delayable(&procedural_work);
    }
    ensure_base_art_locked();
    draw_procedural_mouth_locked(resolved_state, from_frame_index,
                                 to_frame_index, blend_amount);
    k_mutex_unlock(&procedural_render_mutex);

    if (is_error) {
        (void)k_work_reschedule(&procedural_work,
                                K_MSEC(KOALA_ERROR_ALARM_MS));
    }
}
```

## src/koala_abs_compat.c
```c
int ABS(int value)
{
    return value < 0 ? -value : value;
}
```

## src/loading_display.h
```c
#ifndef KOALABYTE_T114_LOADING_DISPLAY_H
#define KOALABYTE_T114_LOADING_DISPLAY_H

#include <stdbool.h>
#include <stdint.h>

bool loading_display_init(void);
bool loading_display_ready(void);
void render_killerkoala_boot_splash(void);
void render_koalagotchi_action(const char *action_title, uint8_t frame_index);
void render_loading_banner(const char *banner);
void render_killerkoala_mouth(const char *state, const char *message,
                              uint8_t from_frame_index,
                              uint8_t to_frame_index,
                              uint8_t blend_amount);
void render_menu_status(const char *message);

/* Canonical centered Koalagotchi HUD state. */
void koala_centered_set_status(int health, const char *mood,
                               const char *expression);
void koala_centered_set_action_progress(int progress_percent);

void loading_display_end(void);

#endif
```

## src/loading_display_compat.c
```c
/*
 * KoalaByte Blue T114 loading-display compatibility backend.
 *
 * NCS v2.9 uses an older Zephyr devicetree model than the current upstream
 * Heltec T114 board definition. The imported board exposes VEXT, TFT enable,
 * and backlight aliases in a form that cannot be consumed safely by the older
 * GPIO devicetree macros.
 *
 * Keep the public loading-display API available while the first-flash build
 * focuses on USB CDC, BLE, GNSS, and UF2 output. A native NCS v2.9 display
 * implementation can replace this file later without changing main.c.
 */

#include "loading_display.h"

bool loading_display_init(void)
{
    return false;
}

bool loading_display_ready(void)
{
    return false;
}

void render_loading_banner(const char *banner)
{
    (void)banner;
}

void loading_display_end(void)
{
}
```
